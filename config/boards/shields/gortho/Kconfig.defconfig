## config/boards/shields/gortho/Kconfig.defconfig
```kconfig
config ZMK_BLE
	default y

config ZMK_USB
	default n

if SHIELD_GORTHO
            
config ZMK_KEYBOARD_NAME
    default "Gortho"

endif
```
